## drivers/firmware/riscv/Kconfig
```kconfig
# SPDX-License-Identifier: GPL-2.0-only
menu "Risc-V Specific firmware drivers"
depends on RISCV

config RISCV_DOUBLE_TRAP
	bool "Enable double trap handling"
	depends on RISCV_SSE && RISCV_SBI
	default y
	help
	  Select if you want to enable SSE double trap handler. In case of a
	  double trap generated by the kernel, the SBI will generate and SSE
	  event allowing the (soon-to-die) kernel to display debugging
	  information.

config RISCV_SSE
	bool "Enable SBI Supervisor Software Events support"
	depends on RISCV_SBI
	default y
	help
	  The Supervisor Software Events support allow the SBI to deliver
	  NMI-like notifications to the supervisor mode software. When enable,
	  this option provides support to register callbacks on specific SSE
	  events.

endmenu
```
